## Kconfig
```kconfig
#
# For a description of the syntax of this configuration file,
# see Documentation/kbuild/kconfig-language.txt.
#
mainmenu "Linux/$ARCH $KERNELVERSION Kernel Configuration"

config SRCARCH
	string
	option env="SRCARCH"

source "arch/$SRCARCH/Kconfig"

#liqiang@wind-mobi.com 20180207 begin
config WIND_PRO_A306
	bool "CONFIG_WIND_PRO_A306"
	default n
	help
		Select y or n
config WIND_PRO_E300LWW
	bool "CONFIG_WIND_PRO_E300LWW"
	default n
	help
		Select y or n
#liqiang@wind-mobi.com 20180207 end
```

## drivers/input/touchscreen/Mastar_TP/Kconfig
```kconfig
#
# MASTAR Touchscreen driver configuration
#

# zhaopengfei@wind-mobi.com 20180713 begin

config TOUCHSCREEN_MSG2836
        tristate "MSG2836 chipset touchscreen"
		depends on I2C
		help
		This enables support for MSG2836 CHIPSET over I2C based touchscreens.
```
